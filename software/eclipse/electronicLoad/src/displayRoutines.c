#include "displayRoutines.h"

const char font12x16[256][24] = { { 0x00, 0x00, 0x00, 0x00, 0x00, 0x00, 0x00,
		0x00, 0x00, 0x00, 0x00, 0x00, 0x00, 0x00, 0x00, 0x00, 0x00, 0x00, 0x00,
		0x00, 0x00, 0x00, 0x00, 0x00 },	// 0x00
		{ 0x00, 0x00, 0xC0, 0x0F, 0x30, 0x30, 0x08, 0x40, 0x88, 0x4C, 0x44,
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				0x00, 0x00, 0x00 } 	// 0xFF
};

const char font6x8[256][6] = { { 0x00, 0x00, 0x00, 0x00, 0x00, 0x00 },	// 0x00
		{ 0x00, 0x7C, 0xA2, 0x8A, 0xA2, 0x7C },	// 0x01
		{ 0x00, 0x7C, 0xD6, 0xF6, 0xD6, 0x7C },	// 0x02
		{ 0x00, 0x38, 0x7C, 0x3E, 0x7C, 0x38 },	// 0x03
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		{ 0x00, 0x00, 0x00, 0x00, 0x00, 0x00 } 	// 0xFF
};

/*
 * clears the entire dispaly
 */
void display_Clear(void) {
	uint16_t i;
	for (i = 0; i < 1024; i++)
		display.buffer[i] = 0;
}

/*
 * sets or clears a specific pixel in the display data buffer
 * (no data is actual transmitted to the display, only the *internal*
 * buffer is modified)
 */
void display_SetPixel(uint8_t x, uint8_t y, PixelState_t s) {
	// calculate byteoffset
	uint16_t byte = x * 8 + y / 8;
	uint8_t bit = 1 << (y % 8);
	if (s == PIXEL_ON) {
		display.buffer[byte] |= bit;
	} else {
		display.buffer[byte] &= ~bit;
	}
}

void display_SetByte(uint8_t x, uint8_t page, uint8_t b) {
	if (x >= 128 || page >= 8)
		return;
	display.buffer[x + page * 128] = b;
}

/*
 * transfers a character into the display buffer by copying the whole bytes
 * (fast but limited to 8 lines in y direction)
 * 0<=x<=115
 * 0<=y<=7
 */
void display_FastChar12x16(uint8_t x, uint8_t ypage, char c) {
	if (x >= 128 || ypage >= 7)
		return;
	uint8_t i;
	for (i = 0; i < 12; i++) {
		display_SetByte(x + i, ypage, font12x16[(uint8_t) c][i * 2]);
		display_SetByte(x + i, ypage + 1, font12x16[(uint8_t) c][i * 2 + 1]);
	}
}

/*
 * transfers a character into the display buffer by copying the whole bytes
 * (fast but limited to 8 lines in y direction)
 * 0<=x<=122
 * 0<=y<=7
 */
void display_FastChar6x8(uint8_t x, uint8_t ypage, char c) {
	if (x >= 128 || ypage >= 8)
		return;
	uint8_t i;
	for (i = 0; i < 6; i++) {
		display_SetByte(x + i, ypage, font6x8[(uint8_t) c][i]);
	}
}

void display_FastString12x16(char *src, uint8_t x, uint8_t ypage) {
	while (*src) {
		display_FastChar12x16(x, ypage, *src++);
		x += 12;
	}
}

void display_FastString6x8(char *src, uint8_t x, uint8_t ypage) {
	while (*src) {
		display_FastChar6x8(x, ypage, *src++);
		x += 6;
	}
}

void display_UpdateDefaultScreen(void) {
	char buffer[12];
	uint32_t voltage = hal_getVoltage();
	uint32_t current = hal_getCurrent();
	uint32_t power = voltage * current / 1000000;

	string_fromUint(voltage / 10, buffer, 4, 2);
	buffer[5] = 'V';
	buffer[6] = 0;
	display_FastString12x16(buffer, 0, 0);

	string_fromUint(current / 10, buffer, 4, 2);
	buffer[5] = 'A';
	buffer[6] = 0;
	display_FastString12x16(buffer, 0, 2);

	string_fromUint(power, buffer, 6, 3);
	buffer[7] = 'W';
	buffer[8] = 0;
	display_FastString12x16(buffer, 0, 4);

	uint8_t i;
	for (i = 0; i < 21; i++) {
		display_FastChar5x8(i * 6, 6, display.defScreen[0][i]);
		display_FastChar5x8(i * 6, 7, display.defScreen[1][i]);
	}
}
